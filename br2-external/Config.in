## br2-external/Config.in
```kconfig
source "$BR2_EXTERNAL_WARP_PATH/package/xdriver_xf86-video-warp/Config.in"
source "$BR2_EXTERNAL_WARP_PATH/package/jwm/Config.in"
source "$BR2_EXTERNAL_WARP_PATH/package/tint2/Config.in"
source "$BR2_EXTERNAL_WARP_PATH/package/tango-icon-theme/Config.in"
source "$BR2_EXTERNAL_WARP_PATH/package/warptool/Config.in"
```

## br2-external/package/fbdoom/Config.in
```kconfig
config BR2_PACKAGE_FBDOOM
	bool "fbdoom"
	help
	  fbDOOM: the Doom engine (Chocolate Doom based) on the Linux
	  console frame buffer and keyboard, with the shareware
	  doom1.wad (episode 1) from Debian's doom-wad-shareware.

	  Run "doom" from a virtual console: a 320x200 window in the
	  current console mode, or "doom -mode 640x480" for full screen
	  (scaled x2); -scaling N, -pckeys for a USB keyboard alone.
	  Patched for big-endian m68k, the Amiga keyboard and speed on
	  the 68040/68060.

	  https://github.com/maximevince/fbDOOM
```

## br2-external/package/jwm/Config.in
```kconfig
config BR2_PACKAGE_JWM
	bool "jwm"
	depends on BR2_PACKAGE_XORG7
	select BR2_PACKAGE_XLIB_LIBX11
	select BR2_PACKAGE_XLIB_LIBXEXT
	select BR2_PACKAGE_XLIB_LIBXINERAMA
	select BR2_PACKAGE_XLIB_LIBXMU
	select BR2_PACKAGE_XLIB_LIBXPM
	select BR2_PACKAGE_LIBPNG
	help
	  JWM (Joe's Window Manager): a light window manager with a
	  taskbar, start menu, pager, tray and clock in one process.

	  Built with core X fonts only (no Xft, Pango, Cairo, RSVG or
	  XRender), so its text goes through the X server's core font
	  path, which the Warp X driver accelerates.

	  https://joewing.net/projects/jwm/
```

## br2-external/package/tango-icon-theme/Config.in
```kconfig
config BR2_PACKAGE_TANGO_ICON_THEME
	bool "tango-icon-theme"
	select BR2_PACKAGE_HICOLOR_ICON_THEME
	help
	  The Tango icon theme, its 16, 22 and 32 pixel PNGs only (no
	  SVGs, so no librsvg is needed): about 3 MB, enough for GTK
	  menus, panels and 32 px desktop icons.

	  http://tango.freedesktop.org/
```

## br2-external/package/tint2/Config.in
```kconfig
config BR2_PACKAGE_TINT2
	bool "tint2"
	depends on BR2_PACKAGE_XORG7
	depends on BR2_USE_WCHAR # libglib2
	depends on BR2_TOOLCHAIN_HAS_THREADS # libglib2
	depends on BR2_USE_MMU # libglib2
	depends on BR2_INSTALL_LIBSTDCPP # pango -> harfbuzz
	depends on BR2_TOOLCHAIN_HAS_SYNC_4 # pango -> harfbuzz
	depends on BR2_TOOLCHAIN_GCC_AT_LEAST_4_9 # pango -> harfbuzz
	select BR2_PACKAGE_CAIRO
	select BR2_PACKAGE_PANGO
	select BR2_PACKAGE_LIBGLIB2
	select BR2_PACKAGE_IMLIB2
	select BR2_PACKAGE_IMLIB2_PNG
	select BR2_PACKAGE_IMLIB2_X
	select BR2_PACKAGE_XLIB_LIBX11
	select BR2_PACKAGE_XLIB_LIBXCOMPOSITE
	select BR2_PACKAGE_XLIB_LIBXDAMAGE
	select BR2_PACKAGE_XLIB_LIBXEXT
	select BR2_PACKAGE_XLIB_LIBXINERAMA
	select BR2_PACKAGE_XLIB_LIBXRANDR
	select BR2_PACKAGE_XLIB_LIBXRENDER
	help
	  tint2: a light panel and taskbar (launchers, task list,
	  system tray, clock), for Openbox and other window managers.

	  Built without tint2conf (GTK), the battery applet, extra
	  themes and SVG icons.

	  https://gitlab.com/o9000/tint2
```

## br2-external/package/warptool/Config.in
```kconfig
config BR2_PACKAGE_WARPTOOL
	bool "warptool"
	depends on BR2_m68k
	help
	  CS-Lab Warp board status and settings: diagnostic data, 68k
	  clock, L2 cache and audio mixer.  The Linux counterpart of
	  AmigaOS WarpTool, with the same keywords; it works through
	  the kernel's cswarp-ctl sysfs files.
```

## br2-external/package/xdriver_xf86-video-warp/Config.in
```kconfig
config BR2_PACKAGE_XDRIVER_XF86_VIDEO_WARP
	bool "xf86-video-warp"
	depends on BR2_m68k
	depends on BR2_PACKAGE_XSERVER_XORG_SERVER_MODULAR
	help
	  Xorg driver for the CS-Lab Warp RTG frame buffer (amiwarpfb):
	  shadow frame buffer pushed to VRAM with move16, blitter copies
	  and fills, FPGA sprite as the hardware cursor.
	  Use Driver "warp" in xorg.conf.
```
